## conf/distro/camol-v2012.12.conf
```bitbake
#@--------------------------------------------------------------------
#@TYPE: Distribution
#@NAME: Cambrionix Linux <http://www.cambrionix.com>
#@DESCRIPTION: The Linux Distribution for Kernel 3.8 based devices
#@MAINTAINER: Cambrionix IT <it@cambrionix.com>
#@--------------------------------------------------------------------

DISTRO_VERSION = "v2012.12"

OLDEST_KERNEL = "2.6.16"

require conf/distro/include/sane-srcdates.inc
require conf/distro/include/sane-srcrevs.inc
require conf/distro/include/camol-preferred-versions.inc

#Images built can have to modes:
# 'debug': empty rootpassword, strace included
# 'release' no root password, no strace and gdb by default
DISTRO_TYPE ?= "debug"
#DISTRO_TYPE = "release"

# Set the toolchain type (internal, external) and brand (generic, csl etc.)
TOOLCHAIN_TYPE ?= "internal"
TOOLCHAIN_BRAND ?= ""

# Ship just basic locale by default. Locales are big (~1Mb uncompr.), so
# shipping some adhoc subset will be still useless and size burden for
# users of all other languages/countries. Instead, worth to make it easy
# to install additional languages: installer/wizard + metapackages which
# will RRECOMMEND as much as possible content for a given language
# (locales, UI transalations, help, etc. - useless for pros, but really 
# helpful for common users).
# Also, it appears that no locales fit in 16Mb for now. "C" locale rules!
IMAGE_LINGUAS ?= '${@base_less_or_equal("ROOT_FLASH_SIZE", "16", "", "en-us", d)}'

# set feed path variables
FEED_BASEPATH = "feeds/v2012.12/${CAMOL_PKG_FORMAT}/${TCLIBC}/"

#This is unrelated to the kernel version, but userspace apps (e.g. udev/systemd) require a recent version to build against
LINUX_LIBC_HEADERS_VERSION ?= "3.4%"
PREFERRED_VERSION_linux-libc-headers = "${LINUX_LIBC_HEADERS_VERSION}"
PREFERRED_VERSION_linux-libc-headers-native = "${LINUX_LIBC_HEADERS_VERSION}"
PREFERRED_VERSION_linux-libc-headers-nativesdk = "${LINUX_LIBC_HEADERS_VERSION}"


CAMOL_EGLIBC_VERSION                 ?= "2.16"
CAMOL_UCLIBC_VERSION                 ?= "0.9.33+git%"

PREFERRED_VERSION_uclibc        	?= "${CAMOL_UCLIBC_VERSION}"
PREFERRED_VERSION_uclibc-initial	?= "${CAMOL_UCLIBC_VERSION}"
PREFERRED_VERSION_uclibc-nativesdk     	?= "${CAMOL_UCLIBC_VERSION}"
PREFERRED_VERSION_uclibc-initial-nativesdk ?= "${CAMOL_UCLIBC_VERSION}"

PREFERRED_VERSION_eglibc		?= "${CAMOL_EGLIBC_VERSION}"
PREFERRED_VERSION_eglibc-initial	?= "${CAMOL_EGLIBC_VERSION}"
PREFERRED_VERSION_eglibc-nativesdk	?= "${CAMOL_EGLIBC_VERSION}"
PREFERRED_VERSION_eglibc-initial-nativesdk ?= "${CAMOL_EGLIBC_VERSION}"
PREFERRED_VERSION_eglibc-locale		?= "${CAMOL_EGLIBC_VERSION}"
PREFERRED_VERSION_cross-localedef-native ?= "${CAMOL_EGLIBC_VERSION}"

PREFERRED_VERSION_systemd		= "211"

# Blackfin has its on gcc
CAMOL_GCC_VERSION_bfin			= "4.1.2"

#avr32 only has support for gcc 4.2.2
CAMOL_GCC_VERSION_avr32		         ?= "4.2.2"

CAMOL_GCC_VERSION_arm 			  = "linaro-4.7%"

#Everybody else can just use this: 
CAMOL_GCC_VERSION                             ?= "4.7%"

CAMOL_BINUTILS_VERSION                        ?= "2.22"

PREFERRED_VERSION_binutils                       ?= "${CAMOL_BINUTILS_VERSION}"
PREFERRED_VERSION_binutils-cross                 ?= "${CAMOL_BINUTILS_VERSION}"
PREFERRED_VERSION_binutils-crosssdk              ?= "${CAMOL_BINUTILS_VERSION}"
PREFERRED_VERSION_binutils-cross-canadian-${TRANSLATED_TARGET_ARCH} ?= "${CAMOL_BINUTILS_VERSION}"
PREFERRED_VERSION_gcc-cross-canadian-${TRANSLATED_TARGET_ARCH} ?= "${CAMOL_GCC_VERSION}"

PREFERRED_VERSION_gcc                            ?= "${CAMOL_GCC_VERSION}"
PREFERRED_VERSION_gcc-cross                      ?= "${CAMOL_GCC_VERSION}"
PREFERRED_VERSION_gcc-cross-initial              ?= "${CAMOL_GCC_VERSION}"
PREFERRED_VERSION_gcc-cross-intermediate         ?= "${CAMOL_GCC_VERSION}"
PREFERRED_VERSION_gcc-cross-canadian             ?= "${CAMOL_GCC_VERSION}"
PREFERRED_VERSION_gcc-crosssdk                   ?= "${CAMOL_GCC_VERSION}"
PREFERRED_VERSION_gcc-crosssdk-initial           ?= "${CAMOL_GCC_VERSION}"
PREFERRED_VERSION_gcc-crosssdk-intermediate      ?= "${CAMOL_GCC_VERSION}"
PREFERRED_VERSION_gcc-runtime                    ?= "${CAMOL_GCC_VERSION}"
PREFERRED_VERSION_gcc-runtime-nativesdk          ?= "${CAMOL_GCC_VERSION}"
PREFERRED_VERSION_libgcc                         ?= "${CAMOL_GCC_VERSION}"
PREFERRED_VERSION_libgcc-nativesdk               ?= "${CAMOL_GCC_VERSION}"

PREFERRED_VERSION_gnupg = "1.4.7"

#avr32 only has patches for binutils 2.17 in OE
PREFERRED_VERSION_binutils_avr32 = "2.17"
PREFERRED_VERSION_binutils-cross_avr32 = "2.17"
PREFERRED_VERSION_binutils-cross-sdk_avr32 = "2.17"

PREFERRED_PROVIDER_dbus-glib             = "dbus-glib"
PREFERRED_PROVIDER-gconf-dbus            = "gconf"
PREFERRED_PROVIDER_hotplug               = "systemd"
PREFERRED_PROVIDER_opkg                 ?= "opkg"
PREFERRED_PROVIDER_opkg-native          ?= "opkg-native"
PREFERRED_PROVIDER_udev                  = "systemd"

# blacklist policy

PNBLACKLIST[pn-fso-apm]       = "regular apmd is good enough"
PNBLACKLIST[gconf-dbus]        = "gconf-dbus has been merged back into main GConf"
PNBLACKLIST[gconf-dbus-native] = "gconf-dbus has been merged back into main GConf"
PNBLACKLIST[ffmpeg] = "libav is preferred over ffmpeg"
PNBLACKLIST[udev] = "systemd-udevd is preferred over the obsolete udev"

require conf/distro/include/camol.inc

# Toolchain virtuals:
require conf/distro/include/toolchain-${TOOLCHAIN_TYPE}.inc

# Set DISTRO_FEED_CONFIGS to our config var, assigned in the above .inc
DISTRO_FEED_CONFIGS = "${CAMOL_FEED_CONFIGS}"

# If we're using an .ipk based rootfs, we want to have opkg installed so postinst script can run
# We also take this opportunity to inject camol-version and the feed configs into the rootfs
IPKG_VARIANT = "opkg camol-version ${CAMOL_FEED_CONFIGS}"

# Select xserver-xorg as default, since kdrive has been EOL'ed
XSERVER ?= "xserver-xorg xf86-input-evdev xf86-input-keyboard xf86-input-mouse xf86-video-fbdev" 

# do some packagegroup-base stuff here

# Prefer bluez4, it's needed for things like connman. Bluez4 is also largely backward compatible with
# bluez 3.x
DISTRO_BLUETOOTH_MANAGER = "\
	blueprobe \
	bluez4 \
   "

# We want to ship extra debug utils in the rootfs when doing a debug build 
DEBUG_APPS ?= ""
DEBUG_APPS += '${@base_conditional("DISTRO_TYPE", "release", "", "strace procps",d)}'

# This hooks into packagegroup-base, so it won't do anything if your images doesn't include packagegroup-base.
# camol-version: ship this to have an identifiable rootfs so user can report bugs against a specific version
# CAMOL_FEED_CONFIGS: configfiles for the online feeds
# util-linux-mount util-linux-umount: busybox mount is broken
# camol-libc-fixup-hack: fixes an obscure bug with libc.so symlink
DISTRO_EXTRA_RDEPENDS += "\
    camol-version \
    ${CAMOL_FEED_CONFIGS} \
    util-linux-mount util-linux-umount \
    camol-libc-fixup-hack \
    "

# This also hooks into packagegroup-base, but isn't mandatory.
# If you don't want parts of this in your packagegroup-base using images you can put this in the image recipe:
# BAD_RECOMMENDATIONS = "avahi-daemon avahi-autoipd"
# Note that BAD_RECOMMENDATIONS is a feature of rootfs_ipk.bbclass, not camol
# kernel modules: ship fs modules so you can mount stuff and af-packet so networking works
# avahi: makes finding your device on the network a lot easier
# openssh-sftp-server: provides sftp which combined with avahi makes it real easy to use things like sshfs
# psplash-camol: camol branded psplash, you can add your own psplash-foo to an image, it uses update-alternatives
# DEBUG_APPS: ship strace and procpc to make simple debugging a lot easier
DISTRO_EXTRA_RRECOMMENDS += " \
    kernel-module-vfat \
    kernel-module-ext2 \
    kernel-module-ext3 \
    kernel-module-af-packet \
    avahi-daemon \
    avahi-autoipd \
    openssh-sftp-server \
    ${DEBUG_APPS} \
"

SPLASH ?= ' ${@base_contains("MACHINE_FEATURES", "screen", "psplash-camol", "",d)}'

DISTRO_FEATURES += "${LDISGOLD}"
#LDISGOLD_arm = "ld-is-gold"
LDISGOLD_x86 = "ld-is-gold"
LDISGOLD_x86_64 = "ld-is-gold"
LDISGOLD = ""
```

## conf/distro/camol.conf
```bitbake
#@--------------------------------------------------------------------
#@TYPE: Distribution
#@NAME: Cambrionix Linux <http://www.cambrionix.com>
#@DESCRIPTION: The Linux Distribution for Kernel 3.14 based devices
#@MAINTAINER: Cambrionix IT <it@cambrionix.com>
#@--------------------------------------------------------------------

DISTRO_VERSION = "v${@time.strftime('%Y.%m',time.gmtime())}"

require conf/distro/include/sane-srcdates.inc
require conf/distro/include/sane-srcrevs.inc
require conf/distro/include/camol-preferred-versions.inc

#Images built can have to modes:
# 'debug': empty rootpassword, strace included
# 'release' no root password, no strace and gdb by default
DISTRO_TYPE ?= "debug"
#DISTRO_TYPE = "release"

# Set the toolchain type (internal, external) and brand (generic, csl etc.)
TOOLCHAIN_TYPE ?= "internal"
TOOLCHAIN_BRAND ?= ""

# Ship just basic locale by default. Locales are big (~1Mb uncompr.), so
# shipping some adhoc subset will be still useless and size burden for
# users of all other languages/countries. Instead, worth to make it easy
# to install additional languages: installer/wizard + metapackages which
# will RRECOMMEND as much as possible content for a given language
# (locales, UI transalations, help, etc. - useless for pros, but really 
# helpful for common users).
# Also, it appears that no locales fit in 16Mb for now. "C" locale rules!
ROOT_FLASH_SIZE ??= "32"
IMAGE_LINGUAS ?= '${@base_less_or_equal("ROOT_FLASH_SIZE", "16", "", "en-us", d)}'

# set feed path variables
FEED_BASEPATH = "feeds/next/${CAMOL_PKG_FORMAT}/${TCLIBC}/"


#Everybody else can just use this:
CAMOL_GCC_VERSION                             ?= "4.9%"
CAMOL_BINUTILS_VERSION                        ?= "2.27%"
CAMOL_GDB_VERSION                             ?= "7.9%"

#use Linaro tools for ARM
CAMOL_GCC_VERSION_arm                         ?= "linaro-4.9%"
CAMOL_BINUTILS_VERSION_arm                    ?= "linaro-%"
CAMOL_GDB_VERSION_arm                         ?= "linaro-%"
CAMOL_GCC_VERSION_aarch64                     ?= "linaro-4.9%"
CAMOL_BINUTILS_VERSION_aarch64                ?= "linaro-%"
CAMOL_GDB_VERSION_aarch64                     ?= "linaro-%"
PREFERRED_VERSION_cross-localedef-native         ?= "2.2%"

CAMOL_QEMU_VERSION                            ?= "2%"

GCCVERSION                                       = "${CAMOL_GCC_VERSION}"
BINUVERSION                                      = "${CAMOL_BINUTILS_VERSION}"
GDBVERSION                                       = "${CAMOL_GDB_VERSION}"
PREFERRED_VERSION_qemu                           = "${CAMOL_QEMU_VERSION}"
PREFERRED_VERSION_qemu-native                    = "${CAMOL_QEMU_VERSION}"
PREFERRED_VERSION_nativesdk-qemu                 = "${CAMOL_QEMU_VERSION}"
PREFERRED_VERSION_util-linux			 = "2.30"

PREFERRED_PROVIDER_dbus-glib                     = "dbus-glib"
PREFERRED_PROVIDER-gconf-dbus                    = "gconf"
PREFERRED_PROVIDER_hotplug                       = "systemd"
PREFERRED_PROVIDER_opkg                          ?= "opkg"
PREFERRED_PROVIDER_opkg-native                   ?= "opkg-native"

# Prefer gummiboot over grub
EFI_PROVIDER                                     = "gummiboot"

# blacklist policy

PNBLACKLIST[pn-fso-apm]       = "regular apmd is good enough"
PNBLACKLIST[gconf-dbus]        = "gconf-dbus has been merged back into main GConf"
PNBLACKLIST[gconf-dbus-native] = "gconf-dbus has been merged back into main GConf"
PNBLACKLIST[ffmpeg] = "libav is preferred over ffmpeg"

require conf/distro/include/camol.inc

# Toolchain virtuals:
require conf/distro/include/toolchain-${TOOLCHAIN_TYPE}.inc
# Processor specific tunes like hard float ABI
include conf/distro/include/${TARGET_ARCH}-defaults.inc
# Set DISTRO_FEED_CONFIGS to our config var, assigned in the above .inc
DISTRO_FEED_CONFIGS = "${CAMOL_FEED_CONFIGS}"

# If we're using an .ipk based rootfs, we want to have opkg installed so postinst script can run
# We also take this opportunity to inject camol-version and the feed configs into the rootfs
IPKG_VARIANT = "opkg camol-version ${CAMOL_FEED_CONFIGS}"

# Select xserver-xorg as default, since kdrive has been EOL'ed
XSERVER ?= "xserver-xorg xf86-input-evdev xf86-input-keyboard xf86-input-mouse xf86-video-fbdev"

# do some packagegroup-base stuff here

# Prefer bluez4, it's needed for things like connman. Bluez4 is also largely backward compatible with
# bluez 3.x
DISTRO_BLUETOOTH_MANAGER = "\
	blueprobe \
	bluez5 \
   "

KERNEL_MODULE_PACKAGE_SUFFIX = ""

# We want to ship extra debug utils in the rootfs when doing a debug build
DEBUG_APPS ?= ""
DEBUG_APPS += '${@base_conditional("DISTRO_TYPE", "release", "", "strace procps",d)}'

# This hooks into packagegroup-base, so it won't do anything if your images doesn't include packagegroup-base.
# camol-version: ship this to have an identifiable rootfs so user can report bugs against a specific version
# CAMOL_FEED_CONFIGS: configfiles for the online feeds
# util-linux-mount util-linux-umount: busybox mount is broken
# camol-libc-fixup-hack: fixes an obscure bug with libc.so symlink
DISTRO_EXTRA_RDEPENDS += "\
    camol-version \
    ${CAMOL_FEED_CONFIGS} \
    util-linux-mount util-linux-umount \
    camol-libc-fixup-hack \
    "

# This also hooks into packagegroup-base, but isn't mandatory.
# If you don't want parts of this in your packagegroup-base using images you can put this in the image recipe:
# BAD_RECOMMENDATIONS = "avahi-daemon avahi-autoipd"
# Note that BAD_RECOMMENDATIONS is a feature of rootfs_ipk.bbclass, not camol
# kernel modules: ship fs modules so you can mount stuff and af-packet so networking works
# openssh-sftp-server: provides sftp which combined with avahi makes it real easy to use things like sshfs
# DEBUG_APPS: ship strace and procpc to make simple debugging a lot easier
DISTRO_EXTRA_RRECOMMENDS += " \
    kernel-module-vfat \
    kernel-module-ext2 \
    kernel-module-ext3 \
    kernel-module-af-packet \
    bonjour \
    bonjour-camol \
    openssh-sftp-server \
    ${DEBUG_APPS} \
"
```

## conf/distro/include/camol-package-ipk.inc
```bitbake
INHERIT += "package_ipk"

CAMOL_FEED_CONFIGS ?= "camol-feed-configs"

EXTRAOPKGCONFIG = "opkg-config-base ${CAMOL_FEED_CONFIGS}"

CAMOL_IPK_UPDATE_ALTERNATIVES ?= "update-alternatives-opkg"

DISTRO_UPDATE_ALTERNATIVES = "${CAMOL_IPK_UPDATE_ALTERNATIVES}"

# we need the same provider for opkg and u-a
PREFERRED_PROVIDER_virtual/update-alternatives-native ?= "opkg-utils-native"
PREFERRED_PROVIDER_virtual/update-alternatives = "opkg-utils"
VIRTUAL-RUNTIME_update-alternatives = "${CAMOL_IPK_UPDATE_ALTERNATIVES}"
```

## conf/distro/include/camol-preferred-versions.inc
```bitbake
CAMOL_MESA_VERSION = "8.0.4%"
CAMOL_QT_VERSION ?= "4.8.1"

PREFERRED_VERSION_gobject-introspection-native = "0.9.10"
PREFERRED_VERSION_mesa          = "${CAMOL_MESA_VERSION}"
PREFERRED_VERSION_mesa-dri      = "${CAMOL_MESA_VERSION}"
PREFERRED_VERSION_mesa-xlib     = "${CAMOL_MESA_VERSION}"
PREFERRED_VERSION_qt4-native = "${CAMOL_QT_VERSION}"
PREFERRED_VERSION_qt4-tools-native = "${CAMOL_QT_VERSION}"
PREFERRED_VERSION_qt4-tools-nativesdk = "${CAMOL_QT_VERSION}"
PREFERRED_VERSION_qt4-tools-sdk = "${CAMOL_QT_VERSION}"
PREFERRED_VERSION_qt4-embedded = "${CAMOL_QT_VERSION}"
PREFERRED_VERSION_qt4-embedded-gles = "${CAMOL_QT_VERSION}"
PREFERRED_VERSION_qt4-x11-free = "${CAMOL_QT_VERSION}"
PREFERRED_VERSION_qt4-x11-free-gles = "${CAMOL_QT_VERSION}"
PREFERRED_VERSION_udev = "182"

UDEV_GE_141 = "1"
```

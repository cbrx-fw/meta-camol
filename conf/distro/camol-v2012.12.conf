## conf/layer.conf
```bitbake
# We have a conf and classes directory, append to BBPATH
BBPATH .= ":${LAYERDIR}"

# We have a recipes directory, add to BBFILES
BBFILES += "${LAYERDIR}/recipes*/*/*.bb ${LAYERDIR}/recipes*/*/*.bbappend"

BBFILE_COLLECTIONS += "camol-layer"
BBFILE_PATTERN_camol-layer := "^${LAYERDIR}/"
BBFILE_PRIORITY_camol-layer = "7"

SIGGEN_EXCLUDERECIPES_ABISAFE += " \
	camol-feed-configs \
        "

LICENSE_PATH += "${LAYERDIR}/licenses"

LAYERSERIES_COMPAT_camol-layer = "sumo"
```
